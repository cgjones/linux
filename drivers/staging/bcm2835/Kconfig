## drivers/staging/bcm2835/Kconfig
```kconfig
config BCM_V3D
	tristate "Broadcom OpenGL engine support"
	default N
	help
	  Broadcom OpenGL engine support
config BCM_BMEM_SIZE_MiB
	int "BMEM allocation size"
	depends on BCM_V3D
	default 60
	help
		Broadcom Unified Memory Allocator allocation size
```
